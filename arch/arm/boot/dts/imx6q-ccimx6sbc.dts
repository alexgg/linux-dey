// SPDX-License-Identifier: GPL-2.0 OR X11
/*
 * Copyright 2019 Digi International, Inc.
 */

/dts-v1/;

#include "imx6q-ccimx6som.dtsi"
#include "imx6qdl-ccimx6sbc.dtsi"

/ {
	model = "Digi International ConnectCore 6 SBC";
	compatible = "digi,ccimx6sbc", "digi,ccimx6som", "fsl,imx6q";
};

&fec {
	status = "okay";
};

&uart4 {
	status = "okay";
};

